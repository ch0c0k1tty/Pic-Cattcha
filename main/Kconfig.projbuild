## main/Kconfig.projbuild
```kconfig
menu "Pic-Cattcha"
    config PIC_CATTCHA_SELFTEST
        bool "Run hardware self-test at boot instead of the normal camera"
        default n
        help
            Checks the OV7670 wiring, frame capture, filter, JPEG encode and flash storage,
            prints PASS/FAIL per test on the serial monitor, then stops.
endmenu
```

## sdkconfig.defaults
```kconfig
CONFIG_IDF_TARGET="esp32s3"
CONFIG_ESPTOOLPY_FLASHSIZE_8MB=y
CONFIG_PARTITION_TABLE_CUSTOM=y
CONFIG_PARTITION_TABLE_CUSTOM_FILENAME="partitions.csv"
# PSRAM (N8R8/N16R8 = octal; use CONFIG_SPIRAM_MODE_QUAD=y for R2 modules) for the QVGA frame buffers
CONFIG_SPIRAM=y
CONFIG_SPIRAM_USE_CAPS_ALLOC=y
CONFIG_SPIRAM_MODE_OCT=y
CONFIG_SPIRAM_SPEED_80M=y
# OV7670 driver in esp32-camera
CONFIG_OV7670_SUPPORT=y
CONFIG_OV2640_SUPPORT=n
# Bluetooth LE (NimBLE), BLE only
CONFIG_BT_ENABLED=y
CONFIG_BT_NIMBLE_ENABLED=y
CONFIG_BT_NIMBLE_ATT_PREFERRED_MTU=247
CONFIG_BT_NIMBLE_MSYS_1_BLOCK_COUNT=40
CONFIG_BT_NIMBLE_ROLE_CENTRAL=n
CONFIG_BT_NIMBLE_ROLE_OBSERVER=n
CONFIG_FATFS_LFN_NONE=y
```
